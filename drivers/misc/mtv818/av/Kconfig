## drivers/misc/mtv818/av/Kconfig
```kconfig
config TDMB_MTV818_AV
    tristate "Raontech TDMB AV module support"
    depends on SPI || I2C
    help
      This enables support for the RAONTECH TDMB module=======
```

## drivers/misc/mtv818/tpeg/Kconfig
```kconfig
config TDMB_MTV818_TPEG
    tristate "Raontech TDMB TPEG module support"
    depends on SPI || I2C
    help
      This enables support for the RAONTECH TDMB module=======
```

## drivers/misc/nxb110/Kconfig
```kconfig
config MTV_NXB110
    tristate "NXB100 TDMB&1SEG module support"
    depends on SPI || I2C
    help
      This enables support for the NXB110 module=======
```

## drivers/misc/nxb111_tdmb/Kconfig
```kconfig
config MTV_NXB111_TDMB
    tristate "NXB111 TDMB module support"
    depends on SPI || I2C
    help
      This enables support for the NXB110 module
```

## drivers/misc/nxdtv/Kconfig
```kconfig
#
# NXDTV config states
#

config NXDTV_TDMB
	bool "Nexell TDMB Broadcast"
	help
	  This allows TDMB.
choice
	depends on NXDTV_TDMB
	prompt "TDMB"
	default NXDTV_TDMB_1CHIP_AV_TPEG

	config NXDTV_TDMB_1CHIP_AV_ONLY
		bool "1 chip: AV only"

	config NXDTV_TDMB_1CHIP_AV_TPEG
		bool "1 chip: AV and TPEG"

	config NXDTV_TDMB_2CHIP_AV_TPEG
		bool "2 chips: AV and TPEG"
endchoice


config NXDTV_ISDBT_ONESEG
	bool "Nexell ISDB-T 1seg Broadcast"
	help
	  This allows ISDB-T 1seg.

config NXDTV_ISDBT_FULLSEG
	bool "Nexell ISDB-T fullseg Broadcast"
     	depends on (I2C && NXP_MP2TS_IF)
    	default n
	help
	  This allows ISDB-T fullseg.
	  
```

## drivers/misc/samsung_vd/Kconfig
```kconfig
config SAMSUNG_DIGITAL_CINEMA_FPGA
    bool "Support I2C Samsung Digital Cinema FPGA board"
    depends on I2C && PLAT_S5P6818_DIGITAL_CINEMA
	default n
    help
      Say Y here if you have a samsung digital cinema FPGA board feature.
```

## drivers/net/ethernet/nexell/nxpmac/Kconfig
```kconfig
config NXPMAC_ETH
	tristate "Nexell 10/100/1000 Ethernet driver"
	depends on HAS_IOMEM && HAS_DMA
	select MII
	select PHYLIB
	select CRC32
	select PTP_1588_CLOCK
	---help---
	  This is the driver for the Ethernet IPs are built around a
	  Synopsys IP Core and only tested on the Nexell platforms.

if NXPMAC_ETH

config NXPMAC_PLATFORM
	bool "NXPMAC Platform bus support"
	depends on NXPMAC_ETH
	default y
	---help---
	  This selects the platform specific bus support for
	  the nxpmac device driver. This is the driver used
	  on many embedded STM platforms based on ARM and SuperH
	  processors.
	  If you have a controller with this interface, say Y or M here.

	  If unsure, say N.

config NXPMAC_PCI
	bool "NXPMAC PCI bus support"
	depends on NXPMAC_ETH && PCI
	---help---
	  This is to select the Synopsys DWMAC available on PCI devices,
	  if you have a controller with this interface, say Y or M here.

	  This PCI support is tested on XLINX XC2V3000 FF1152AMT0221
	  D1215994A VIRTEX FPGA board.

	  If unsure, say N.

choice
    prompt "Select NXPMAC TX CLK"
    depends on NXPMAC_ETH
    default CLK_SRC_EXT

config CLK_SRC_0
	bool "PLL 0"

config CLK_SRC_1
	bool "PLL 1"

config CLK_SRC_2
	bool "PLL 2"

config CLK_SRC_3
	bool "PLL 3"

config CLK_SRC_EXT
	bool "external rx clk"

endchoice

config NXPMAC_TX_CLK
    int 
    default 0 if CLK_SRC_0
    default 1 if CLK_SRC_1
    default 2 if CLK_SRC_2
    default 3 if CLK_SRC_3
	default 4 if CLK_SRC_EXT

if NXPMAC_TX_CLK != CLK_SRC_EXT

config NXPMAC_TX_CLK_SHIFT
	bool "NXPMAC TX CLK shift" if NXPMAC_TX_CLK != 4

config NXPMAC_TX_CLK_DELAY
	bool "NXPMAC TX CLK delay"
	default n
	---help---
	  Using TX CLK delay


endif # NXPMAC_TX_CLK


config NXPMAC_DEBUG_FS
	bool "Enable monitoring via sysFS "
	default n
	depends on NXPMAC_ETH && DEBUG_FS
	---help---
	  The nxpmac entry in /sys reports DMA TX/RX rings
	  or (if supported) the HW cap register.

config NXPMAC_DA
	bool "NXPMAC DMA arbitration scheme"
	default n
	---help---
	  Selecting this option, rx has priority over Tx (only for Giga
	  Ethernet device).
	  By default, the DMA arbitration scheme is based on Round-robin
	  (rx:tx priority is 1:1).

endif
```

## drivers/usb/hub/Kconfig
```kconfig
#
# USB Imaging devices configuration
#
comment "USB Hub devices"
	depends on USB

config USB_HUB_USB2514
	tristate "USB Hub USB2514 support"
	depends on USB
	---help---
	  Say Y here if you want to connect this type of still camera to
	  your computer's USB port. This driver can be used with gphoto 0.4.3
	  and higher (look at <http://www.gphoto.org/>).
	  To use it create a device node with "mknod /dev/mustek c 180 32" and
	  configure it in your software.

	  To compile this driver as a module, choose M here: the
	  module will be called mdc800.
```

## drivers/video/nexell/Kconfig.resc
```kconfig
#
# Video configuration
#

menu "Graphics support"
	depends on HAS_IOMEM

config FB_SLSI_ION_MEM
	bool "Allocate framebuffer with ION "
	depends on FB_SLSI
	select ION
	select ION_SLSI
	default n

config FB0_SLSI
	bool "Support primary   frame buffer (/dev/fb0)"
	depends on FB_SLSI
	select NXP_DISPLAY
	select NXP_DISPLAY_1ST
	default y

	config FB0_SLSI_DISPOUT
		int "Display Out [0/1]"
		depends on FB0_SLSI
		default 0

config FB1_SLSI
	bool "Support secondary frame buffer (/dev/fb1)"
	depends on FB_SLSI
	select NXP_DISPLAY
	select NXP_DISPLAY_2ST
	default n

	config FB1_SLSI_DISPOUT
		int "Display Out [0/1]"
		depends on FB1_SLSI
		default 1

config NXP_DISPLAY_LCD
	bool "LCD"
	default n

	config NXP_DISPLAY_LCD_IN
		int "Display In  [0=Display 0, 1=Display 1, 2=Resolution Convertor]"
		depends on NXP_DISPLAY_LCD
		default 0

config NXP_DISPLAY_LVDS
	bool "LVDS"
	default n

	config NXP_DISPLAY_LVDS_IN
		int "Display In  [0=Display 0, 1=Display 1, 2=Resolution Convertor]"
		depends on NXP_DISPLAY_LVDS
		default 0

config NXP_DISPLAY_MIPI
	bool "MIPI"

	config NXP_DISPLAY_MIPI_IN
		int "Display In  [0=Display 0, 1=Display 1, 2=Resolution Convertor]"
		depends on NXP_DISPLAY_MIPI
		default 0

config NXP_DISPLAY_HDMI
	bool "HDMI"

	config NXP_DISPLAY_HDMI_IN
		int "Display In  [0=Display 0, 1=Display 1, 2=Resolution Convertor]"
		depends on NXP_DISPLAY_HDMI
		default 0

	choice
		prompt "Resolution"
		depends on NXP_DISPLAY_HDMI
		default NXP_DISPLAY_HDMI_1280_720P

	config	NXP_DISPLAY_HDMI_1280_720P
		bool "1280 *  720p"

	config	NXP_DISPLAY_HDMI_1920_1080P
		bool "1920 * 1080p"

	endchoice

config NXP_DISPLAY_RESC
	bool "RESOLUTION CONVERTOR"
	default n

	config NXP_DISPLAY_RESC_IN
		int "Display In  [0=Display 0, 1=Display 1]"
		depends on NXP_DISPLAY_RESC
		default 0

endmenu
```

## sound/soc/nexell/Kconfig
```kconfig
#
# Copyright 2010 Nexell.
#
# Configuration options for the S5Pxxx Sound

config SND_NXP_SOC
	tristate "S5Pxxx SoC Audio"
	depends on ARCH_CPU_SLSI
	select AMBA_PL08X
	help
	  Say Y or M if you want to add support for codecs attached to
	  the AC97 and I2S interface.

config SND_NXP_DFS
	bool "DFS featrue for I2S(default PLL2)"
	depends on SND_NXP_SOC
	help
	  Say Y if you want to add DFS feature support for I2S and interface.

choice
    prompt "Select SND PLL device"
    depends on SND_NXP_DFS
    default SND_NXP_PLL_2

config SND_NXP_PLL_2
    bool "PLL 2"

config SND_NXP_PLL_3
    bool "PLL 3"

endchoice

config SND_NXP_PLLDEV
    int
    default 2 if SND_NXP_PLL_2
    default 3 if SND_NXP_PLL_3

config SND_NXP_I2S
	tristate

config SND_NXP_I2S_CH0
	bool "I2S 0"
	depends on SND_NXP_SOC
	select SND_NXP_I2S
	default y

config SND_NXP_I2S_CH1
	bool "I2S 1"
	depends on SND_NXP_SOC
	select SND_NXP_I2S
	default n

config SND_NXP_I2S_CH2
	bool "I2S 2"
	depends on SND_NXP_SOC
	select SND_NXP_I2S
	default n

config SND_NXP_SPDIF_TX
	tristate

config SND_NXP_SPDIF_RX
	tristate

config SND_SPDIF_TRANSCIEVER
	tristate "SPDIF transciever (PCM)"
	depends on SND_NXP_SOC
	select SND_NXP_SPDIF_TX
	select SND_SOC_SPDIF

config SND_SPDIF_RECEIVER
	tristate "SPDIF receiver (PCM)"
	depends on SND_NXP_SOC
	select SND_NXP_SPDIF_RX
	select SND_SOC_SPDIF

config SND_NXP_SPI
	tristate "SPI receiver (PCM)"
	depends on SND_NXP_SOC

choice
	prompt "SPI device"
	depends on SND_NXP_SPI

	config SND_NXP_SPI_PL022
		bool "ARM AMBA PL022 SSP controller"
		help
	  	  This selects the ARM(R) AMBA(R) PrimeCell PL022 SSP
	  	  controller. If you have an embedded system with an AMBA(R)
	  	  bus and a PL022 controller, say Y here.
endchoice

config NOUSE_SND_DAPM
	bool "nouse dapm control for codec"
	depends on SND_NXP_I2S

config SND_CODEC_NULL
	tristate "I2S audio null codec."
	depends on SND_NXP_I2S

config SND_CODEC_TLV320AIC32X4
	tristate "TLV320AIC32X4 I2S audio DAC."
	depends on SND_NXP_I2S
	select SND_SOC_TLV320AIC32X4

config SND_CODEC_RT5631
	tristate "rt5631 I2S audio codec."
	depends on SND_NXP_I2S
	select SND_SOC_RT5631

config SND_CODEC_RT5640
	tristate "rt5640 Dual I2S audio codec."
	depends on SND_NXP_I2S
	select SND_SOC_RT5640

config SND_CODEC_ES8316
	tristate "es8316 I2S audio codec."
	depends on SND_NXP_I2S
	select SND_SOC_ES8316

config SND_CODEC_ALC5623
	tristate "ALC562(123) I2S audio codec."
	depends on SND_NXP_I2S
	select SND_SOC_ALC5623

config SND_CODEC_ALC5633
        tristate "alc5633 I2S audio codec."
        depends on SND_NXP_I2S
        select SND_SOC_ALC5633

config SND_CODEC_WM8976
	tristate "wm8976 (wm8978) I2S audio codec."
	depends on SND_NXP_I2S
	select SND_SOC_WM8978

config SND_CODEC_CS42L51_NX
	tristate "cs42l51 I2S audio codec(S5Pxxx work)."
	depends on SND_NXP_I2S
	select SND_SOC_CS42L51_NX

config SND_CODEC_WM8903
	tristate "wm8903  I2S audio codec."
	depends on SND_NXP_I2S
	select SND_SOC_WM8903

config SND_CODEC_SMARTVOICE
	tristate "Smart voice synchronization codec for spi and i2s."
	depends on SND_NXP_SPI

config SND_NXP_PCM_RATE_DETECTOR
	bool "I2S PCM Sample Rate Detector for Smart Voice"
	depends on SND_CODEC_SMARTVOICE
	help
	  Say Y if you want to use PCM sample rate detector for Smart Voice.
```
