## arch/arm/configs/s5p4418_navi_ref_update_defconfig
```kconfig
CONFIG_EXPERIMENTAL=y
CONFIG_CROSS_COMPILE="arm-eabi-"
# CONFIG_LOCALVERSION_AUTO is not set
CONFIG_DEFAULT_HOSTNAME="S5P4418"
# CONFIG_SWAP is not set
CONFIG_SYSVIPC=y
CONFIG_CGROUPS=y
CONFIG_CGROUP_DEBUG=y
CONFIG_CGROUP_FREEZER=y
CONFIG_CGROUP_CPUACCT=y
CONFIG_RESOURCE_COUNTERS=y
CONFIG_CGROUP_MEM_RES_CTLR=y
CONFIG_CGROUP_SCHED=y
CONFIG_RT_GROUP_SCHED=y
CONFIG_BLK_DEV_INITRD=y
CONFIG_PANIC_TIMEOUT=5
CONFIG_KALLSYMS_ALL=y
# CONFIG_AIO is not set
CONFIG_EMBEDDED=y
CONFIG_PERF_EVENTS=y
CONFIG_MODULES=y
CONFIG_MODULE_FORCE_LOAD=y
CONFIG_MODULE_UNLOAD=y
CONFIG_MODULE_FORCE_UNLOAD=y
CONFIG_BLK_DEV_BSGLIB=y
CONFIG_PARTITION_ADVANCED=y
CONFIG_EFI_PARTITION=y
CONFIG_DEFAULT_NOOP=y
CONFIG_ARCH_S5P4418=y
CONFIG_HZ_1000=y
CONFIG_HAVE_PWM_CH1=y
CONFIG_HAVE_PWM_CH2=y
CONFIG_HAVE_PWM_CH3=y
CONFIG_NXP_DISPLAY=y
CONFIG_NXP_DISPLAY_1ST=y
CONFIG_NXP_DISPLAY_2ST=y
CONFIG_DEFERRED_INIT_CALL=y
CONFIG_PLAT_S5P4418_NAVI_REF=y
CONFIG_NO_HZ=y
CONFIG_HIGH_RES_TIMERS=y
CONFIG_SMP=y
CONFIG_SCHED_MC=y
CONFIG_SCHED_SMT=y
CONFIG_PREEMPT=y
CONFIG_AEABI=y
# CONFIG_OABI_COMPAT is not set
CONFIG_HIGHMEM=y
CONFIG_COMPACTION=y
CONFIG_KSM=y
CONFIG_CMA_DEVELOPEMENT=y
CONFIG_CMA_DEBUG=y
CONFIG_CMA_SYSFS=y
CONFIG_CMA_CMDLINE=y
CONFIG_ARM_FLUSH_CONSOLE_ON_RESTART=y
CONFIG_CMDLINE="console=ttyAMA3,115200n8 root=/dev/ram0 rw initrd=0x49000000,32M ramdisk=32768"
CONFIG_CPU_FREQ=y
CONFIG_CPU_FREQ_GOV_POWERSAVE=y
CONFIG_CPU_FREQ_GOV_USERSPACE=y
CONFIG_CPU_FREQ_GOV_ONDEMAND=y
CONFIG_CPU_FREQ_GOV_INTERACTIVE=y
CONFIG_CPU_FREQ_GOV_CONSERVATIVE=y
CONFIG_CPU_IDLE=y
CONFIG_VFP=y
CONFIG_NEON=y
# CONFIG_CORE_DUMP_DEFAULT_ELF_HEADERS is not set
CONFIG_BINFMT_MISC=y
CONFIG_PM_AUTOSLEEP=y
CONFIG_PM_WAKELOCKS=y
CONFIG_PM_WAKELOCKS_LIMIT=0
# CONFIG_PM_WAKELOCKS_GC is not set
CONFIG_PM_RUNTIME=y
CONFIG_PM_DEBUG=y
CONFIG_SUSPEND_TIME=y
CONFIG_NET=y
CONFIG_PACKET=y
CONFIG_UNIX=y
CONFIG_XFRM_USER=y
CONFIG_NET_KEY=y
CONFIG_INET=y
CONFIG_IP_MULTICAST=y
CONFIG_IP_ADVANCED_ROUTER=y
CONFIG_IP_MULTIPLE_TABLES=y
CONFIG_IP_PNP=y
CONFIG_INET_ESP=y
# CONFIG_INET_LRO is not set
CONFIG_IPV6=y
CONFIG_IPV6_PRIVACY=y
CONFIG_IPV6_ROUTER_PREF=y
CONFIG_IPV6_OPTIMISTIC_DAD=y
CONFIG_INET6_AH=y
CONFIG_INET6_ESP=y
CONFIG_INET6_IPCOMP=y
CONFIG_IPV6_MIP6=y
CONFIG_IPV6_TUNNEL=y
CONFIG_IPV6_MULTIPLE_TABLES=y
CONFIG_NETWORK_SECMARK=y
CONFIG_NETFILTER=y
CONFIG_NF_CONNTRACK=y
CONFIG_NF_CONNTRACK_EVENTS=y
CONFIG_NF_CT_PROTO_DCCP=y
CONFIG_NF_CT_PROTO_SCTP=y
CONFIG_NF_CT_PROTO_UDPLITE=y
CONFIG_NF_CONNTRACK_AMANDA=y
CONFIG_NF_CONNTRACK_FTP=y
CONFIG_NF_CONNTRACK_H323=y
CONFIG_NF_CONNTRACK_IRC=y
CONFIG_NF_CONNTRACK_NETBIOS_NS=y
CONFIG_NF_CONNTRACK_PPTP=y
CONFIG_NF_CONNTRACK_SANE=y
CONFIG_NF_CONNTRACK_TFTP=y
CONFIG_NF_CT_NETLINK=y
CONFIG_NETFILTER_TPROXY=y
CONFIG_NETFILTER_XT_TARGET_CLASSIFY=y
CONFIG_NETFILTER_XT_TARGET_CONNMARK=y
CONFIG_NETFILTER_XT_TARGET_IDLETIMER=y
CONFIG_NETFILTER_XT_TARGET_MARK=y
CONFIG_NETFILTER_XT_TARGET_NFLOG=y
CONFIG_NETFILTER_XT_TARGET_NFQUEUE=y
CONFIG_NETFILTER_XT_TARGET_TPROXY=y
CONFIG_NETFILTER_XT_TARGET_TRACE=y
CONFIG_NETFILTER_XT_MATCH_COMMENT=y
CONFIG_NETFILTER_XT_MATCH_CONNBYTES=y
CONFIG_NETFILTER_XT_MATCH_CONNLIMIT=y
CONFIG_NETFILTER_XT_MATCH_CONNMARK=y
CONFIG_NETFILTER_XT_MATCH_CONNTRACK=y
CONFIG_NETFILTER_XT_MATCH_HASHLIMIT=y
CONFIG_NETFILTER_XT_MATCH_HELPER=y
CONFIG_NETFILTER_XT_MATCH_IPRANGE=y
CONFIG_NETFILTER_XT_MATCH_LENGTH=y
CONFIG_NETFILTER_XT_MATCH_LIMIT=y
CONFIG_NETFILTER_XT_MATCH_MAC=y
CONFIG_NETFILTER_XT_MATCH_MARK=y
CONFIG_NETFILTER_XT_MATCH_PKTTYPE=y
CONFIG_NETFILTER_XT_MATCH_QTAGUID=y
CONFIG_NETFILTER_XT_MATCH_QUOTA=y
CONFIG_NETFILTER_XT_MATCH_QUOTA2=y
CONFIG_NETFILTER_XT_MATCH_QUOTA2_LOG=y
CONFIG_NETFILTER_XT_MATCH_SOCKET=y
CONFIG_NETFILTER_XT_MATCH_STATE=y
CONFIG_NETFILTER_XT_MATCH_STATISTIC=y
CONFIG_NETFILTER_XT_MATCH_STRING=y
CONFIG_NETFILTER_XT_MATCH_TIME=y
CONFIG_NETFILTER_XT_MATCH_U32=y
CONFIG_NF_CONNTRACK_IPV4=y
CONFIG_IP_NF_IPTABLES=y
CONFIG_IP_NF_MATCH_AH=y
CONFIG_IP_NF_MATCH_ECN=y
CONFIG_IP_NF_MATCH_TTL=y
CONFIG_IP_NF_FILTER=y
CONFIG_IP_NF_TARGET_REJECT=y
CONFIG_IP_NF_TARGET_REJECT_SKERR=y
CONFIG_NF_NAT=y
CONFIG_IP_NF_TARGET_MASQUERADE=y
CONFIG_IP_NF_TARGET_NETMAP=y
CONFIG_IP_NF_TARGET_REDIRECT=y
CONFIG_IP_NF_MANGLE=y
CONFIG_IP_NF_RAW=y
CONFIG_IP_NF_ARPTABLES=y
CONFIG_IP_NF_ARPFILTER=y
CONFIG_IP_NF_ARP_MANGLE=y
CONFIG_NF_CONNTRACK_IPV6=y
CONFIG_IP6_NF_IPTABLES=y
CONFIG_IP6_NF_FILTER=y
CONFIG_IP6_NF_TARGET_REJECT=y
CONFIG_IP6_NF_TARGET_REJECT_SKERR=y
CONFIG_IP6_NF_MANGLE=y
CONFIG_IP6_NF_RAW=y
CONFIG_PHONET=y
CONFIG_NET_SCHED=y
CONFIG_NET_SCH_HTB=y
CONFIG_NET_CLS_U32=y
CONFIG_NET_EMATCH=y
CONFIG_NET_EMATCH_U32=y
CONFIG_NET_CLS_ACT=y
CONFIG_NET_ACT_POLICE=y
CONFIG_NET_ACT_GACT=y
CONFIG_NET_ACT_MIRRED=y
CONFIG_DNS_RESOLVER=y
CONFIG_CFG80211=y
CONFIG_NL80211_TESTMODE=y
# CONFIG_CFG80211_DEFAULT_PS is not set
# CONFIG_CFG80211_WEXT is not set
CONFIG_DEVTMPFS=y
CONFIG_DEVTMPFS_MOUNT=y
CONFIG_SYNC=y
CONFIG_SW_SYNC=y
CONFIG_SW_SYNC_USER=y
CONFIG_BLK_DEV_LOOP=y
CONFIG_UID_STAT=y
CONFIG_SLSIAP_CODA960=y
CONFIG_SLSIAP_BACKWARD_CAMERA=y
CONFIG_SCSI=y
CONFIG_BLK_DEV_RAM=y
CONFIG_BLK_DEV_RAM_COUNT=16
CONFIG_BLK_DEV_RAM_SIZE=32768
CONFIG_BLK_DEV_SD=y
CONFIG_CHR_DEV_SG=y
CONFIG_MD=y
CONFIG_BLK_DEV_DM=y
CONFIG_DM_CRYPT=y
CONFIG_DM_UEVENT=y
CONFIG_NETDEVICES=y
# CONFIG_ETHERNET is not set
CONFIG_USB_USBNET=y
CONFIG_USB_NET_RNDIS_HOST=y
# CONFIG_USB_NET_CDC_SUBSET is not set
CONFIG_USB_IPHETH=y
# CONFIG_WLAN is not set
CONFIG_INPUT_FF_MEMLESS=y
# CONFIG_INPUT_MOUSEDEV is not set
CONFIG_INPUT_EVDEV=y
# CONFIG_KEYBOARD_ATKBD is not set
CONFIG_KEYBOARD_NXP_KEY=y
# CONFIG_INPUT_MOUSE is not set
CONFIG_INPUT_TOUCHSCREEN=y
CONFIG_TOUCHSCREEN_TSC2007=y
CONFIG_INPUT_MISC=y
CONFIG_INPUT_UINPUT=y
CONFIG_INPUT_GPIO=y
# CONFIG_SERIO is not set
# CONFIG_CONSOLE_TRANSLATIONS is not set
# CONFIG_LEGACY_PTYS is not set
CONFIG_SERIAL_AMBA_PL011=y
CONFIG_SERIAL_AMBA_PL011_CONSOLE=y
CONFIG_SERIAL_NXP_UART1=y
CONFIG_SERIAL_NXP_UART2=y
CONFIG_SERIAL_NXP_UART3=y
CONFIG_HW_RANDOM=y
CONFIG_I2C=y
CONFIG_I2C_CHARDEV=y
CONFIG_I2C_GPIO=y
CONFIG_I2C_NXP=y
# CONFIG_I2C_NXP_PORT0 is not set
CONFIG_I2C_NXP_PORT1=y
CONFIG_I2C_NXP_PORT2=y
CONFIG_SPI=y
CONFIG_SPI_PL022=y
CONFIG_SPI_PL022_PORT0=y
CONFIG_USE_DMA_PORT0=y
CONFIG_SPI_SPIDEV=y
CONFIG_GPIO_SYSFS=y
CONFIG_GPIO_NXP=y
CONFIG_GPIO_NXP_GROUP_A=y
CONFIG_GPIO_NXP_GROUP_B=y
CONFIG_GPIO_NXP_GROUP_C=y
CONFIG_GPIO_NXP_GROUP_D=y
CONFIG_GPIO_NXP_GROUP_E=y
CONFIG_GPIO_NXP_GROUP_ALV=y
CONFIG_POWER_SUPPLY=y
CONFIG_SENSORS_NXP_ADC_TEMP=y
CONFIG_WATCHDOG=y
CONFIG_WATCHDOG_CORE=y
CONFIG_REGULATOR=y
CONFIG_REGULATOR_NXE2000=y
CONFIG_MEDIA_SUPPORT=y
CONFIG_MEDIA_CONTROLLER=y
CONFIG_VIDEO_DEV=y
CONFIG_VIDEO_V4L2_SUBDEV_API=y
# CONFIG_RC_CORE is not set
# CONFIG_MEDIA_TUNER_CUSTOMISE is not set
CONFIG_VIDEOBUF2_ION_NXP=y
CONFIG_V4L2_NXP=y
CONFIG_VIDEO_NXP_CAPTURE=y
CONFIG_NXP_CAPTURE_DECIMATOR=y
CONFIG_NXP_CAPTURE_MIPI_CSI=y
CONFIG_VIDEO_NXP_M2M=y
CONFIG_NXP_M2M_SCALER=y
CONFIG_ENABLE_SCALER_MISC_DEVICE=y
CONFIG_USE_SCALER_COMMAND_BUFFER=y
# CONFIG_NXP_M2M_DEINTERLACER is not set
CONFIG_VIDEO_NXP_OUT=y
CONFIG_NXP_OUT_RESOLUTION_CONVERTER=y
CONFIG_NXP_OUT_HDMI=y
CONFIG_NXP_HDMI_CEC=y
CONFIG_VIDEO_NVP6114A=y
# CONFIG_NVP6114A_GENERAL is not set
CONFIG_NVP6114A_BACKWARD=y
CONFIG_USB_VIDEO_CLASS=y
# CONFIG_RADIO_ADAPTERS is not set
CONFIG_ION_NXP_CONTIGHEAP_SIZE=196608
CONFIG_VR400=y
# CONFIG_VR400_PROFILING is not set
CONFIG_VR_SHARED_INTERRUPTS=y
CONFIG_FB=y
CONFIG_FB_MODE_HELPERS=y
CONFIG_FB_NXP=y
CONFIG_BACKLIGHT_LCD_SUPPORT=y
CONFIG_LCD_CLASS_DEVICE=y
CONFIG_BACKLIGHT_CLASS_DEVICE=y
# CONFIG_BACKLIGHT_GENERIC is not set
CONFIG_BACKLIGHT_PWM=y
CONFIG_FB_NXP_ION_MEM=y
CONFIG_NXP_DISPLAY_LVDS=y
CONFIG_LOGO=y
# CONFIG_LOGO_LINUX_MONO is not set
# CONFIG_LOGO_LINUX_VGA16 is not set
# CONFIG_LOGO_LINUX_CLUT224 is not set
CONFIG_LOGO_NXP_COPY=y
CONFIG_SOUND=y
CONFIG_SND=y
# CONFIG_SND_SUPPORT_OLD_API is not set
# CONFIG_SND_VERBOSE_PROCFS is not set
# CONFIG_SND_DRIVERS is not set
# CONFIG_SND_ARM is not set
# CONFIG_SND_SPI is not set
CONFIG_SND_USB_AUDIO=y
CONFIG_SND_SOC=y
CONFIG_SND_NXP_SOC=y
CONFIG_SND_NXP_I2S_CH1=y
CONFIG_SND_SPDIF_TRANSCIEVER=y
CONFIG_NOUSE_SND_DAPM=y
CONFIG_SND_CODEC_RT5640=y
CONFIG_SND_CODEC_ALC5623=y
CONFIG_USB_HIDDEV=y
CONFIG_HID_IUI=y
CONFIG_USB=y
CONFIG_USB_ANNOUNCE_NEW_DEVICES=y
# CONFIG_USB_DEVICEFS is not set
CONFIG_USB_DYNAMIC_MINORS=y
CONFIG_USB_EHCI_HCD=y
CONFIG_USB_EHCI_SYNOPSYS=y
CONFIG_USB_EHCI_SYNOPSYS_RESUME_WORK=y
CONFIG_USB_DWCOTG=y
CONFIG_USB_STORAGE=y
CONFIG_USB_GADGET=y
CONFIG_USB_GADGET_DWCOTG=y
CONFIG_USB_G_ANDROID=y
CONFIG_USB_HUB_USB2514=y
CONFIG_MMC=y
CONFIG_MMC_UNSAFE_RESUME=y
CONFIG_MMC_DW=y
CONFIG_MMC_DW_IDMAC=y
CONFIG_MMC_NXP_CH1=y
CONFIG_SWITCH=y
CONFIG_RTC_CLASS=y
CONFIG_RTC_DRV_NXP=y
CONFIG_DMADEVICES=y
CONFIG_AMBA_PL08X_USE_ISR=y
CONFIG_STAGING=y
CONFIG_IIO=y
CONFIG_IIO_BUFFER=y
CONFIG_IIO_SW_RING=y
CONFIG_IIO_KFIFO_BUF=y
CONFIG_NXP_ADC=y
CONFIG_ANDROID=y
CONFIG_ANDROID_BINDER_IPC=y
CONFIG_ASHMEM=y
CONFIG_ANDROID_LOGGER=y
CONFIG_ANDROID_RAM_CONSOLE=y
CONFIG_ANDROID_TIMED_GPIO=y
CONFIG_ANDROID_LOW_MEMORY_KILLER=y
CONFIG_ANDROID_INTF_ALARM_DEV=y
# CONFIG_IOMMU_SUPPORT is not set
CONFIG_EXT2_FS=y
CONFIG_EXT4_FS=y
CONFIG_EXT4_FS_POSIX_ACL=y
CONFIG_EXT4_FS_SECURITY=y
# CONFIG_DNOTIFY is not set
CONFIG_AUTOFS4_FS=y
CONFIG_FUSE_FS=y
CONFIG_MSDOS_FS=y
CONFIG_VFAT_FS=y
CONFIG_TMPFS=y
CONFIG_TMPFS_POSIX_ACL=y
# CONFIG_MISC_FILESYSTEMS is not set
# CONFIG_NETWORK_FILESYSTEMS is not set
CONFIG_NLS_CODEPAGE_437=y
CONFIG_NLS_ASCII=y
CONFIG_NLS_ISO8859_1=y
CONFIG_PRINTK_TIME=y
# CONFIG_ENABLE_WARN_DEPRECATED is not set
# CONFIG_ENABLE_MUST_CHECK is not set
# CONFIG_SCHED_DEBUG is not set
# CONFIG_DEBUG_PREEMPT is not set
# CONFIG_STACKTRACE is not set
# CONFIG_DEBUG_BUGVERBOSE is not set
# CONFIG_RCU_CPU_STALL_VERBOSE is not set
# CONFIG_FTRACE is not set
# CONFIG_ARM_UNWIND is not set
CONFIG_KEYS=y
CONFIG_SECURITY=y
CONFIG_SECURITY_NETWORK=y
CONFIG_CRYPTO_ECB=y
CONFIG_CRYPTO_AES=y
CONFIG_CRYPTO_ARC4=y
CONFIG_CRYPTO_TWOFISH=y
CONFIG_CRYPTO_LZO=y
# CONFIG_CRYPTO_ANSI_CPRNG is not set
# CONFIG_CRYPTO_HW is not set
CONFIG_CRC_CCITT=y
```

## arch/arm/mach-nxp4330/Kconfig
```kconfig
#
# Copyright 2009 Nexell.
#

config ARCH_CPU_NEXELL
	bool
	default y

choice
	prompt "Prototype build mode"
	default PROTOTYPE_RELEASE

config  PROTOTYPE_RELEASE
	bool "Release"

config  PROTOTYPE_DEBUG
	bool "Debug"
endchoice

choice
	prompt "Memory max order"
	default MEM_MAX_ORDER_11

config	MEM_MAX_ORDER_11
	bool "4Mbyte"

config	MEM_MAX_ORDER_12
    bool "8Mbyte"

config	MEM_MAX_ORDER_13
	bool "16Mbyte"

endchoice

config FORCE_MAX_ZONEORDER
   	int
   	default 11 if MEM_MAX_ORDER_11
   	default 12 if MEM_MAX_ORDER_12
   	default 13 if MEM_MAX_ORDER_13

comment "CPU feature"

config SUSPEND_IDLE
	bool "Goto idle when Suspend"
	depends on SUSPEND
	default n

config PM_DBGOUT
	bool "Support PM_DBGOUT"
	default n

config HAVE_PWM
	prompt "PWM driver"
	bool
	select NEXELL_SOC_PWM
	default y

config PWM_SYSFS
	bool "/sys/devices/platform/pwm.N (sysfs interface)"
	depends on HAVE_PWM
	default y

config HAVE_PWM_CH0
	bool "pwm 0"
	depends on HAVE_PWM
	default y

config HAVE_PWM_CH1
	bool "pwm 1"
	depends on HAVE_PWM
	default n

config HAVE_PWM_CH2
	bool "pwm 2"
	depends on HAVE_PWM
	default n

config HAVE_PWM_CH3
	bool "pwm 3"
	depends on HAVE_PWM
	default n

config NEXELL_SOC_PWM
	bool "Support PWM SoC"
	default y if HAVE_PWM

config NEXELL_DISPLAY
	bool "Support Display SoC"
	default n

config NEXELL_DISPLAY_1ST
	bool "Primary   display output (MLC0/DPC0)"
	depends on NEXELL_DISPLAY

config NEXELL_DISPLAY_2ST
	bool "Secondary display output (MLC1/DPC1)"
	depends on NEXELL_DISPLAY

config NEXELL_DISPLAY_RESCONV
	bool "Resolution Converter"
	depends on NEXELL_DISPLAY
	default n

source "kernel/Kconfig.hz"
source "arch/arm/plat-nxp4330/Kconfig"
```

## arch/arm/mach-nxp4330/soc/hdmi/Kconfig
```kconfig
choice
    prompt "HDMI Audio Interface"
    depends on NXP_OUT_HDMI || NEXELL_DISPLAY_HDMI
    default NXP_HDMI_AUDIO_SPDIF
    help
      Choose which interface to use for hdmi audio output

config NXP_HDMI_AUDIO_SPDIF
    bool "SPDIF"

config NXP_HDMI_AUDIO_I2S
    bool "I2S"

endchoice

config NXP_HDMI_USE_HDCP
    depends on NXP_OUT_HDMI || NEXELL_DISPLAY_HDMI
    bool "HDMI use HDCP block"
    default n
    ---help---
      Say y here to enable hdcp module
```
