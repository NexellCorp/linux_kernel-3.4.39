## arch/arm/mach-s5p4418/Kconfig
```kconfig
#
# Copyright 2009 Nexell.
#

config ARCH_CPU_SLSI
	bool
	default y
	select ARM_ERRATA_754322
	select ARM_ERRATA_775420

choice
	prompt "Prototype build mode"
	default S5P4418_PROTO_RELEASE

config  S5P4418_PROTO_RELEASE
	bool "Release"

config  S5P4418_PROTO_DEBUG
	bool "Debug"
endchoice

choice
	prompt "Memory max order"
	default S5P4418_MEM_MAX_ORDER_11

config	S5P4418_MEM_MAX_ORDER_11
	bool "4Mbyte"

config	S5P4418_MEM_MAX_ORDER_12
    bool "8Mbyte"

config	S5P4418_MEM_MAX_ORDER_13
	bool "16Mbyte"

endchoice

config FORCE_MAX_ZONEORDER
   	int
   	default 11 if S5P4418_MEM_MAX_ORDER_11
   	default 12 if S5P4418_MEM_MAX_ORDER_12
   	default 13 if S5P4418_MEM_MAX_ORDER_13

comment "CPU feature"

choice
	prompt "CPU Suspend"
	default SUSPEND_POWEROFF

	config SUSPEND_POWEROFF
		bool "Goto Power Off when Suspend"
		depends on SUSPEND

	config SUSPEND_IDLE
		bool "Goto idle when Suspend"
		depends on SUSPEND
endchoice

config CPU_S5P4418_SMP_ISR
	bool "Support multiple interrupt service routine"
	default y

config CPU_S5P4418_EX_PERI_BUS
	bool "Assign Exclusive Bus for IO"
	default y

config HAVE_PWM
	prompt "PWM driver"
	bool
	select NXP_PWM
	default y

config HAVE_PWM
	prompt "PWM driver"
	bool
	select NXP_PWM
	default y

config PWM_SYSFS
	bool "/sys/devices/platform/pwm.N (sysfs interface)"
	depends on HAVE_PWM
	default y

config HAVE_PWM_CH0
	bool "pwm 0"
	depends on HAVE_PWM
	default y

config HAVE_PWM_CH1
	bool "pwm 1"
	depends on HAVE_PWM
	default n

config HAVE_PWM_CH2
	bool "pwm 2"
	depends on HAVE_PWM
	default n

config HAVE_PWM_CH3
	bool "pwm 3"
	depends on HAVE_PWM
	default n

config NXP_PWM
	bool "Support PWM SoC"
	default y if HAVE_PWM

config NXP_DISPLAY
	bool "Support Display SoC"
	default n

config NXP_DISPLAY_1ST
	bool "Primary   display output (MLC0/DPC0)"
	depends on NXP_DISPLAY

config NXP_DISPLAY_2ST
	bool "Secondary display output (MLC1/DPC1)"
	depends on NXP_DISPLAY

config NXP_DISPLAY_RESCONV
	bool "Resolution Converter"
	depends on NXP_DISPLAY
	default n

config NXP_DFS_BCLK
    bool "DFS For BCLK"
    default n

choice
    prompt "Select BCLK PLL device"
    depends on NXP_DFS_BCLK
    default S5P4418_DFS_BCLK_PLL_0

config S5P4418_DFS_BCLK_PLL_0
    bool "PLL 0"

config S5P4418_DFS_BCLK_PLL_1
    bool "PLL 1"

endchoice

config ANDROID_PERSISTENT_RAM_CONS_AREA
    hex "RAM console physical hex address"
    depends on ANDROID_RAM_CONSOLE
    default 0x0

config ANDROID_PERSISTENT_RAM_CONS_SIZE
    int "RAM console size (KB)"
    depends on ANDROID_RAM_CONSOLE
    default 16

config PM_DBGOUT
	bool "Support PM_DBGOUT"
	default n

source "arch/arm/plat-s5p4418/Kconfig"

#------------------------------------------------ 
# falinux zeroboot boot configuration 
#------------------------------------------------ 
menu "Falinux zeroboot support" 

config FALINUX_ZEROBOOT
	bool "support falinux zeroboot"
	depends on ARCH_S5P4418
	---help---
	  No information. 

config FALINUX_ZEROBOOT_NAL
	bool "suppoet zeroboot nal"
	depends on FALINUX_ZEROBOOT
	---help---
	  No information. 

config  FALINUX_NAND_BBT_SURPORT
    bool "suppoet zeroboot nand bbt"
    depends on FALINUX_ZEROBOOT
    ---help---
      No information.

config  FALINUX_NAND_BBT_ROOTFS_SURPORT
    bool "suppoet zeroboot nand bbt for rootfs"
    depends on FALINUX_NAND_BBT_SURPORT
    ---help---
      No information.

choice
	prompt "FALINUX Board select"
	default CONFIG_ZEROBOOT_S5P4418
	depends on FALINUX_ZEROBOOT 

config ZEROBOOT_S5P4418
	bool	"NEXELL S5p4418"

config ZEROBOOT_MX6Q_SABREAUTO
	bool    "MX6q sabre auto Board" 

config ZEROBOOT_NXP5430
	bool	"NEXELL NXP5430"

endchoice 

config FALINUX_ZEROBOOT_MEM_STORAGE
	bool "suppoet zeroboot mem storage driver"
	depends on FALINUX_ZEROBOOT
	---help---
	  No information. 

endmenu 
```

## arch/arm/mach-s5p4418/soc/hdmi/Kconfig
```kconfig
choice
    prompt "HDMI Audio Interface"
    depends on SLSI_OUT_HDMI
    default SLSI_HDMI_AUDIO_SPDIF
    help
      Choose which interface to use for hdmi audio output

config SLSI_HDMI_AUDIO_SPDIF
    depends on SLSI_OUT_HDMI
    bool "SPDIF"

config SLSI_HDMI_AUDIO_I2S
    depends on SLSI_OUT_HDMI
    bool "I2S"

endchoice

config SLSI_HDMI_USE_HDCP
    depends on SLSI_OUT_HDMI
    bool "HDMI use HDCP block"
    default n
    ---help---
      Say y here to enable hdcp module
```

## arch/arm/mach-slsiap/hdmi/Kconfig
```kconfig
choice
    prompt "HDMI Audio Interface"
    depends on NXP_OUT_HDMI
    default NXP_HDMI_AUDIO_SPDIF
    help
      Choose which interface to use for hdmi audio output

config NXP_HDMI_AUDIO_SPDIF
    depends on NXP_OUT_HDMI
    bool "SPDIF"

config NXP_HDMI_AUDIO_I2S
    depends on NXP_OUT_HDMI
    bool "I2S"

endchoice

config NXP_HDMI_USE_HDCP
    depends on NXP_OUT_HDMI
    bool "HDMI use HDCP block"
    default n
    ---help---
      Say y here to enable hdcp module

config NXP_HDMI_USE_EDID
    depends on NXP_OUT_HDMI
    bool "HDMI use EDID block"
    default y
    ---help---
      Say y here to enable edid module

config PATCH_HDMI_COMPLIANCE_TEST
    depends on NXP_OUT_HDMI
    bool "Enable Patch for HDMI Compliance Test"
    default n
    ---help---
      Say y here to enable patch code for HDMI Compliance Test
```

## arch/arm/plat-nxp4330/Kconfig
```kconfig
#
# Copyright 2009 Nexell.
#
# Configuration options for the NXP4330

config PLAT_NXP4330
	bool
	default y

#
# Select Board
#

comment "Board features"

choice
    prompt "Platform board"
    default PLAT_NXP4330_LYNX

	config PLAT_NXP4330_LYNX
		bool "LYNX: Android MID board"
		help
   	 		Support for the android MID (Lynx) board.

	config PLAT_NXP4330_VTK
		bool "VTK: Validation Kit board"
		help
   	 		Support for the validation kit board.

	config PLAT_NXP4330_SMARTBOX
		bool "SMARTBOX: Android Smart Box"
		help
   	 		Support for the android smart box board.

	config PLAT_NXP4330_PYXIS
		bool "PYXIS: Android Pyxis board"
		help
   	 		Support for the android pysix tablet board.
	
	config PLAT_NXP4330_MORPHEUS
		bool "MORPHEUS: Android morpheus board"
		help
   	 		Support for the android morpheus board.

	config PLAT_NXP4330_SECRET
		bool "SECRET: Android secret board"
		help
   	 		Support for the android secret board.

endchoice

#
# Board dependent configure
#

if PLAT_NX4330_LYNX
source "arch/arm/plat-nxp4330/lynx/Kconfig"
endif
```

## arch/arm/plat-nxp4330/secret/Kconfig
```kconfig
#
# Copyright 2009 Nexell.
#
# Configuration options for the NXP4330

#
# Select Board
#

comment "SECRET Board features"

choice
    prompt "H/W Event Features"
    default SECRET_1ST_BOARD

	config SECRET_1ST_BOARD
		bool "H/W 1st Board"
		help
   	 		SECRET H/W 1st Board.

	config SECRET_2ND_BOARD
		bool "H/W 2nd Board"
		help
   	 		SECRET H/W 2nd Board.

	config SECRET_2P1ND_BOARD
		bool "H/W 2.1 Board"
		help
   	 		SECRET H/W 2.1 Board.

	config SECRET_3RD_BOARD
		bool "H/W 3rd Board"
		help
   	 		SECRET H/W 3rd Board.
endchoice
```

## arch/arm/plat-nxp5430/Kconfig
```kconfig
#
# Copyright 2009 Nexell.
#
# Configuration options for the NXP5430

config PLAT_NXP5430
	bool
	default y

#
# Select Board
#
comment "Board features"

choice
    prompt "Platform board"
    default PLAT_NXP5430_DRONE

	config PLAT_NXP5430_VTK
		bool "VTK: Validation Kit board"
		help
   	 		Support for the validation kit board.

	config PLAT_NXP5430_DRONE
		bool "DRONE: Android drone board"
		help
   	 		Support for the drone board.

endchoice

#
# Board dependent configure
#
```

## arch/arm/plat-s5p4418/Kconfig
```kconfig
#
# Copyright 2009 Nexell.
#

# Select Board types
comment "Board features"

choice
    prompt "Platform board"
    default PLAT_S5P4418_DRONE

	config PLAT_S5P4418_DRONE
		bool "DRONE: Android drone board"
		help
			Support for the drone board.

	config PLAT_S5P4418_SVT
		bool "SVT: Linux svt board"
		help
			Support for the svt board.

	config PLAT_S5P4418_ASB
		bool "ASB: Linux asb board"
		help
			Support for the asb board.

	config PLAT_S5P4418_LEPUS
		bool "LEPUS: Android lepus board"
		help
			Support for the lepus board.

	config PLAT_S5P4418_GENERAL
		bool "GENERAL: Android general board"
		help
			Support for the general board.

	config PLAT_S5P4418_SMART_VOICE
		bool "SMART_VOICE: Android smart_voice board"
		help
			Support for the smart_voice board.

endchoice

#
# Board dependent configure
#
```

## arch/arm/plat-s5p6818/Kconfig
```kconfig
#
# Copyright 2009 Nexell.
#


# Select Board types
comment "Board features"

choice
    prompt "Platform board"
    default PLAT_S5P6818_AVN_REF_BT

   	config PLAT_S5P6818_SVT
		bool "SVT: Android SVT board"
		help
   	 		Support for the SVT board.

   	config PLAT_S5P6818_AVN_REF
		bool "S5P6818 Android AVN board"
		help
   	 		Support for the AVN REF board.

   	config PLAT_S5P6818_AVN_REF_BT
		bool "S5P6818 Android AVN BT board"
		help
   	 		Support for the AVN REF BT board.

    config PLAT_S5P6818_DIGITAL_CINEMA
        bool "S5P6818 Android Digital Cinema board (Samsung VD)"
        help
            Support for the digital cinema board.
endchoice

#
# Board dependent configure
#
```

## drivers/block/nand_ftl/Kconfig
```kconfig
#
# FTL device driver configuration
#

menuconfig NXP_FTL
	bool "NXP NAND FTL"
	select NAND_FTL
	depends on BLOCK
	default y
	---help---

if NXP_FTL

config NAND_FTL
	depends on BLOCK
	depends on ARCH_S5P4418
	default y
	bool "NXP Nand FTL Driver"

endif # NXP_FTL
```

## drivers/inc_dmb/Kconfig
```kconfig
#
# DMB device configuration
#

menuconfig INC_DMB
	bool "DMB support "
	depends on ARCH_S5P6818
#	depends on SPI
	default n
	help
	  TDMB/ISDB-T driver for I&C technology T3A0N, J3000 and newer Chips

config INC_T3A00
	bool "T3A00 for TDMB (I&C Technology)"
	depends on INC_DMB
	default n
	help
	  T3A00 driver for TDMB
```

## drivers/mcucpu/Kconfig
```kconfig
menuconfig MCU_CPU_COMM
	bool "MCU CPU Comm Driver"
	default y

config SMARTA_MCU_CPU_COMM
	bool "MCU CPU Communication Module"
	default y
	depends on MCU_CPU_COMM
	
config SMARTA_BATTERY
	bool "Battery Module"
	default y
	depends on SMARTA_MCU_CPU_COMM
	
```

## drivers/media/dvb/dvb-soc/Kconfig
```kconfig
menuconfig NXP_MP2TS_IF
	bool "NXP MP2TS driver"
	depends on I2C
	default n
	---help---
      	  Say Y to select nxp mp2ts driver

config NXP_MP2TS_WRITE_LOG
	tristate "Enable logging for the write buffer"
	depends on NXP_MP2TS_IF
	help
	  Supports logging of write buffer of MP2TS driver.
          This option is a log that checks the time interval at which
          the mp2ts interrupt occurs.

	  Say Y if you want to use it.

config NXP_MP2TS_IF_FCI
	tristate "Select fc8300 sensor of FCI"
	depends on NXP_MP2TS_IF
	help
	  Support for fc8300 sensor of FCI.

	  Say Y if you own such a device and want to use it.
```

## drivers/media/video/fci8080/Kconfig
```kconfig
config FCI_8080
    bool "FCI 8080 for TDMB"
    default n
    help
      FCI driver for DMB
```

## drivers/media/video/nexell/Kconfig
```kconfig
#
# Nexell multimedia device drivers
#
menuconfig V4L2_SLSI
    bool "Nexell V4L2 Devices"
    depends on ARCH_CPU_SLSI
    select V4L2_MEM2MEM_DEV
    default n
    ---help---
      This is a representative nexell v4l2 device.

if V4L2_SLSI

menuconfig VIDEO_SLSI_CAPTURE
    bool "Nexell Video capture interface"
    depends on V4L2_SLSI
    default n
    ---help---
      Say Y here to enable Nexell Video Capture Interface

if VIDEO_SLSI_CAPTURE
source "drivers/media/video/nexell/capture/Kconfig"
endif

menuconfig VIDEO_SLSI_M2M
    bool "Nexell M2M interface"
    depends on V4L2_SLSI
    default n
    ---help---
      Say y here to enable Nexell M2M scaler or deinterlacer

if VIDEO_SLSI_M2M
source "drivers/media/video/nexell/m2m/Kconfig"
endif

menuconfig VIDEO_SLSI_OUT
    bool "Nexell OUT interface"
    depends on V4L2_SLSI
    default n
    ---help---
      Say y here to enable mlc, resolution converter, hdmi

if VIDEO_SLSI_OUT
source "drivers/media/video/nexell/out/Kconfig"
endif

endif
```

## drivers/media/video/nexell/capture/Kconfig
```kconfig
if VIDEO_NXP_CAPTURE

config NXP_CAPTURE_DECIMATOR
    bool "Enable capture decimator"
    default n
    ---help---
      Say y here to enable decimator

config NXP_CAPTURE_MIPI_CSI
    bool "Enable capture mipi csi interface"
    default n
    ---help---
      Say y here to enable capture mipi csi interface

config NXP_MIPI_CSI_USE_AUTOCLK
    depends on NXP_CAPTURE_MIPI_CSI
    bool "Enable auto clock setting of mipi csi"
    default n
    ---help---
      Say y here to enable auto setting of mipi csi clk source/divider by calculation of resoultion"

config TURNAROUND_VIP_RESET
    bool "Apply turnaround vip reset"
    default n
    ---help---
      Say y here to apply turnaround vip reset code

config LOOPBACK_SENSOR_DRIVER
    bool "Loopback Capture Sensor Driver for Testing"
    default n
    ---help---
      Say y here to add loopback test sensor

endif
```

## drivers/media/video/nexell/m2m/Kconfig
```kconfig
if VIDEO_SLSI_M2M

config SLSI_M2M_SCALER
    bool "Enable scaler"
    default n
    ---help---
      Say y here to enable scaler

config ENABLE_SCALER_MISC_DEVICE
    bool "Enable scaler misc device"
    depends on SLSI_M2M_SCALER
    default n
    ---help---
      Say y here to enable scaler misc device

config USE_SCALER_COMMAND_BUFFER
    bool "Use scaler command buffer engine"
    depends on SLSI_M2M_SCALER
    default n
    ---help---
      Say y here to use command buffer engine

config SLSI_M2M_DEINTERLACER
    bool "Enable deinterlacer"
    default n
    ---help---
      Say y here to enable deinterlacer

endif
```

## drivers/media/video/nexell/out/Kconfig
```kconfig
if VIDEO_SLSI_OUT

config SLSI_OUT_RESOLUTION_CONVERTER
    bool "Enable out resolution converter"
	select NXP_DISPLAY_RESCONV
    default n
    ---help---
      Say y here to enable v4l2 resolution converter

config SLSI_OUT_HDMI
    bool "Enable out HDMI"
    default n
    ---help---
      Say y here to enable v4l2 hdmi

if SLSI_OUT_HDMI
source arch/arm/mach-s5p4418/soc/hdmi/Kconfig
endif

config SLSI_HDMI_CEC
    depends on SLSI_OUT_HDMI || NXP_DISPLAY_HDMI
    bool "Enable HDMI CEC Misc Driver"
    default n
    ---help---
      Say y here to enable hdmi cec module

endif
```

## drivers/media/video/socionext/Kconfig
```kconfig
config VIDEO_M10MO
    tristate "M10MO video decoder(nexell work)"
    depends on I2C && VIDEO_V4L2
    ---help---
	  Support for the Socionext M10MO video decoder.
```

## drivers/media/video/tw/Kconfig
```kconfig
config VIDEO_TW9992
    tristate "TW9992 video decoder(nexell work)"
    depends on I2C && VIDEO_V4L2
    ---help---
	  Support for the Intersil/Techwell TW9992 video decoder.
choice
depends on VIDEO_TW9992
prompt "Camera position for TW9992"
default TW9992_GENERAL
config TW9992_GENERAL
	bool "general camera"
#	depends on ARCH_S5P6818 && !SLSIAP_BACKWARD_CAMERA || NVP6114A_BACKWARD || TW9992_BACKWARD
	depends on ARCH_S5P6818
	help
	  This set as general camera

config TW9992_BACKWARD
	bool "backward camera"
	depends on ARCH_S5P6818 && SLSIAP_BACKWARD_CAMERA
	help
	  This set as backward camera
endchoice

config VIDEO_TW9900
    tristate "TW9900 video decoder(nexell work)"
    depends on I2C && VIDEO_V4L2
    ---help---
      Support for the Intersil/Techwell TW9900 video decoder.
choice
depends on VIDEO_TW9900
prompt "Camera position for TW9900"
default TW9900_GENERAL
config TW9900_GENERAL
	bool "general camera"
	help
	  This set as general camera

config TW9900_BACKWARD
	bool "backward camera"
	depends on SLSIAP_BACKWARD_CAMERA
	help
	  This set as backward camera
endchoice
```

## drivers/misc/coda960/Kconfig
```kconfig
menu "SLSIAP CODA960"
config SLSIAP_CODA960
    bool "SLSIAP CODA960 D/Encoder Driver"
    depends on ARCH_CPU_SLSI
    default n
    ---help---
      This enables CODA960 D/Encoder Device of SLSIAP
endmenu
```
