## drivers/misc/fc8080/Kconfig
```kconfig
config FCI_8080
    tristate "FC8080 TDMB module support"
    depends on SPI || I2C
    help
      This enables support for the FC8080 module=======
```

## drivers/misc/mtv818/Kconfig
```kconfig
config TDMB_MTV818
    tristate "Raontech TDMB/FM/ISDB-T module support"
    depends on SPI || I2C
    help
      This enables support for the RAONTECH TDMB module=======
```
